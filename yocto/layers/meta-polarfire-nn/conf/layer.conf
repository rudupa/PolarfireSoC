## yocto/layers/meta-polarfire-nn/conf/layer.conf
```bitbake
# Layer configuration for meta-polarfire-nn

BBPATH .= ":${LAYERDIR}"
BBFILES += "${LAYERDIR}/recipes-*/*/*.bb \
            ${LAYERDIR}/recipes-*/*/*.bbappend"

BBFILE_COLLECTIONS += "polarfire_nn"
BBFILE_PATTERN_polarfire_nn = "^${LAYERDIR}/"
BBFILE_PRIORITY_polarfire_nn = "7"

LAYERDEPENDS_polarfire_nn = "core"
LAYERSERIES_COMPAT_polarfire_nn = "kirkstone scarthgap"

# Allow recipes to pull assets (kernel fragments, scripts, units) directly from the
# top-level repo so we avoid duplicating files under the layer tree.
FILESEXTRAPATHS:append := "${LAYERDIR}/../../../linux/kernel/fragments:"
FILESEXTRAPATHS:append := "${LAYERDIR}/../../../linux/rootfs/scripts:"
FILESEXTRAPATHS:append := "${LAYERDIR}/../../../linux/rootfs/systemd:"
```

## yocto/layers/meta-polarfire-nn/conf/machine/mpfs-amp.conf
```bitbake
# SPDX-License-Identifier: MIT
# PolarFire SoC AMP machine definition extending the vendor mpfs-disco-kit target.

require ${@bb.utils.which(d.getVar('BBPATH'), 'conf/machine/mpfs-disco-kit.conf')}

MACHINEOVERRIDES =. "mpfs-amp:"

# Shared memory carve-out used by Linux/Zephyr OpenAMP mailboxes.
AMP_SHARED_MEM_BASE ?= "0xB8000000"
AMP_SHARED_MEM_SIZE ?= "0x00200000"

# Hart assignment helper variables consumed by recipes and scripts.
AMP_LINUX_HART ?= "u54_0 u54_1"
AMP_RTOS_HARTS ?= "u54_2 u54_3"
AMP_QNX_HART ?= "u54_2"
AMP_ZEPHYR_HART ?= "u54_3"

# Force Microchip kernel + U-Boot providers from meta-mchp.
PREFERRED_PROVIDER_virtual/kernel ?= "linux-microchip"
PREFERRED_PROVIDER_virtual/bootloader ?= "u-boot-microchip"

SERIAL_CONSOLE ?= "115200 ttyS0"
```

## zephyr/west.yml
```yaml
manifest:
  self:
    path: polarfire-amp-zephyr
    west-commands: modules/zephyr-applications/scripts/west-commands.yml

  remotes:
    - name: zephyrproject-rtos
      url-base: https://github.com/zephyrproject-rtos
    - name: polarfire-soc
      url-base: https://github.com/polarfire-soc

  projects:
    - name: zephyr
      remote: zephyrproject-rtos
      revision: v4.0.0
      import:
        name-allowlist:
          - hal_microchip
          - cmsis
    - name: zephyr-applications
      remote: polarfire-soc
      revision: main
      path: modules/zephyr-applications
```
